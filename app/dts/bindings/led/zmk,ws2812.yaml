## app/dts/bindings/led/zmk,ws2812.yaml
```yaml
description: WS2812/SK6812 LED strip

compatible: "zmk,ws2812"

properties:
  chain-length:
    type: int
    required: true
    description: Number of LEDs in the strip

  color-mapping:
    type: array
    required: true
    description: Channel to color mapping (RGB)

  gpios:
    type: phandle-array
    required: true
    description: Data output pin for the LED strip
```

## app/dts/bindings/ws2812.yaml
```yaml
description: WS2812/SK6812 addressable RGB LED strip

compatible: "worldsemi,ws2812"

properties:
  gpios:
    type: phandle-array
    required: true
    description: GPIO pin used for the data line
  chain-length:
    type: int
    required: true
    description: Number of LEDs in the strip
  color-mapping:
    type: array
    required: false
    description: Color channel order, e.g. <LED_COLOR_ID_RED LED_COLOR_ID_GREEN LED_COLOR_ID_BLUE>
```

## app/module/dts/bindings/zmk,ws2812.yaml
```yaml
# SPDX-License-Identifier: MIT

description: ZMK WS2812 RGB LED strip

compatible: "zmk,ws2812"

include: base.yaml

properties:
  label:
    type: string
    required: true
    description: Human readable string describing the LED strip

  gpios:
    type: phandle-array
    required: true
    description: GPIO pin used to drive the LED strip

  chain-length:
    type: int
    required: true
    description: Number of LEDs in the chain
```

## config/zephyr/dts/bindings/led/zmk,ws2812.yaml
```yaml
# SPDX-License-Identifier: MIT
description: ZMK WS2812/SK6812 Addressable RGB LED Strip

compatible: "zmk,ws2812"

properties:
  gpios:
    type: phandle-array
    required: true
    description: Data output pin for the LED strip

  chain-length:
    type: int
    required: true
    description: Number of LEDs in the strip

  label:
    type: string
    required: true
    description: Human readable name
```

## zephyr/dts/bindings/led/ws2812.yaml
```yaml
description: WS2812/SK6812 addressable RGB LED strip

compatible: "worldsemi,ws2812"

properties:
  gpios:
    type: phandle-array
    required: true
    description: GPIO pin used for the data line
  chain-length:
    type: int
    required: true
    description: Number of LEDs in the strip
  color-mapping:
    type: array
    required: false
    description: Color channel order
```
